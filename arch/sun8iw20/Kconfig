## arch/sun8iw20/Kconfig
```kconfig
config LSP_DIR
	string
	default "default" if (!SIM_PLATFORM && CORE_DSP0 && LSP_NORMAL_START)
	default "jtag" if (!SIM_PLATFORM && CORE_DSP0 && LSP_JTAG_START)
	default "perf_mem" if (!SIM_PLATFORM && CORE_DSP0 && LSP_PERF_MEM_TEST)
```

## drivers/Kconfig
```kconfig
comment "Configure all required driver sub-systems"

config DRIVER_SYSCONFIG
	bool "Rtos Hal support sysconfig.fex"
	default y

menu "SoC related device drivers"

config DRIVERS_CHIP
	bool
	default y

source "drivers/hal/source/prcm/Kconfig"
source "drivers/hal/source/ccmu/Kconfig"
source "drivers/hal/source/uart/Kconfig"
source "drivers/hal/source/intc/Kconfig"
source "drivers/hal/source/dma/Kconfig"
source "drivers/hal/source/gpio/Kconfig"
source "drivers/hal/source/twi/Kconfig"
source "drivers/hal/source/watchdog/Kconfig"
source "drivers/hal/source/msgbox/Kconfig"
source "drivers/hal/source/hwspinlock/Kconfig"
source "drivers/hal/source/timer/Kconfig"
source "drivers/hal/source/sound/Kconfig"

endmenu


menu "Board related device drivers"

config DRIVERS_BOARD
	bool
	default y

source "drivers/board/Kconfig"

endmenu

source "drivers/osal/Kconfig"
```

## rtos-hal/hal/source/sound/Kconfig
```kconfig
menuconfig DRIVERS_SOUND
	bool "Sound card support"
	default y

if DRIVERS_SOUND
config SND_CORE_TINY
	bool "support tiny alsa sound core and alsa-lib"
	default n

source "drivers/hal/source/sound/codecs/Kconfig"
source "drivers/hal/source/sound/platform/Kconfig"
endif # SOUND
```
